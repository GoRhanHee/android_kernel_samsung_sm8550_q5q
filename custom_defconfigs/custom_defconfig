## custom_defconfigs/custom_defconfig
```kconfig
# Disable samsung anti-root stuffs
CONFIG_UH=n
CONFIG_RKP=n
CONFIG_KDP=n 
CONFIG_SECURITY_DEFEX=n
CONFIG_PROCA=n
CONFIG_FIVE=n

# Disable Werror
CONFIG_WERROR=n

# Add LOCALVERSION
CONFIG_LOCALVERSION="-GoRhanHee_Kernel_q5q"
CONFIG_LOCALVERSION_AUTO=n

# KernelSU
CONFIG_KSU=y
CONFIG_KSU_KPROBES_HOOK=n
CONFIG_KSU_LSM_SECURITY_HOOKS=y
CONFIG_KSU_ALLOWLIST_WORKAROUND=y

# SuSFS
CONFIG_KSU_SUSFS=y
CONFIG_KSU_SUSFS_HAS_MAGIC_MOUNT=y
CONFIG_KSU_SUSFS_SUS_PATH=y
CONFIG_KSU_SUSFS_SUS_MOUNT=y
CONFIG_KSU_SUSFS_AUTO_ADD_SUS_KSU_DEFAULT_MOUNT=y
CONFIG_KSU_SUSFS_AUTO_ADD_SUS_BIND_MOUNT=y
CONFIG_KSU_SUSFS_SUS_KSTAT=y
CONFIG_KSU_SUSFS_SUS_OVERLAYFS=n
CONFIG_KSU_SUSFS_TRY_UMOUNT=y
CONFIG_KSU_SUSFS_AUTO_ADD_TRY_UMOUNT_FOR_BIND_MOUNT=y
CONFIG_KSU_SUSFS_SPOOF_UNAME=y
CONFIG_KSU_SUSFS_ENABLE_LOG=y
CONFIG_KSU_SUSFS_HIDE_KSU_SUSFS_SYMBOLS=y
CONFIG_KSU_SUSFS_SPOOF_CMDLINE_OR_BOOTCONFIG=y
CONFIG_KSU_SUSFS_OPEN_REDIRECT=y
CONFIG_KSU_SUSFS_SUS_SU=n
```

## custom_defconfigs/twrp_defconfig
```kconfig
# TWRP Defconfig for q5q
# Disable Scamsung anti-root protection
CONFIG_UH=n
CONFIG_RKP=n
CONFIG_KDP=n 
CONFIG_SECURITY_DEFEX=n
CONFIG_PROCA=n
CONFIG_FIVE=n

# Disable Werror
CONFIG_WERROR=n

# Add LOCALVERSION
CONFIG_LOCALVERSION="-GoRhanHee_Kernel_q5q"
CONFIG_LOCALVERSION_AUTO=n

# KernelSU
CONFIG_KSU=n

# Force SELinux Permissive
CONFIG_SECURITY_SELINUX_ALWAYS_PERMISSIVE=y
CONFIG_SECURITY_SELINUX_ALWAYS_ENFORCE=n
```
